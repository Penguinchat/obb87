## config/boards/shields/obb87/Kconfig.defconfig
```kconfig
# Copyright (c) 2020 The ZMK Contributors
# SPDX-License-Identifier: MIT

if SHIELD_OBB87

config ZMK_KEYBOARD_NAME
	default "obb87"

endif
```

## config/boards/shields/obb87/Kconfig.shield
```kconfig
# Copyright (c) 2020 The ZMK Contributors
# SPDX-License-Identifier: MIT

config SHIELD_OBB87
	def_bool $(shields_list_contains,obb87)
```
